## arch/arm64/crypto/Kconfig
```kconfig
menuconfig ARM64_CRYPTO
	bool "ARM64 Accelerated Cryptographic Algorithms"
	depends on ARM64
	help
	  Say Y here to choose from a selection of cryptographic algorithms
	  implemented using ARM64 specific CPU features or instructions.

if ARM64_CRYPTO

config CRYPTO_SHA1_ARM64_CE
	tristate "SHA-1 digest algorithm (ARMv8 Crypto Extensions)"
	depends on ARM64 && KERNEL_MODE_NEON
	select CRYPTO_HASH

config CRYPTO_SHA2_ARM64_CE
	tristate "SHA-224/SHA-256 digest algorithm (ARMv8 Crypto Extensions)"
	depends on ARM64 && KERNEL_MODE_NEON
	select CRYPTO_HASH

config CRYPTO_GHASH_ARM64_CE
	tristate "GHASH (for GCM chaining mode) using ARMv8 Crypto Extensions"
	depends on ARM64 && KERNEL_MODE_NEON
	select CRYPTO_HASH

config CRYPTO_AES_ARM64_CE
	tristate "AES core cipher using ARMv8 Crypto Extensions"
	depends on ARM64 && KERNEL_MODE_NEON
	select CRYPTO_ALGAPI
	select CRYPTO_AES

config CRYPTO_AES_ARM64_CE_CCM
	tristate "AES in CCM mode using ARMv8 Crypto Extensions"
	depends on ARM64 && KERNEL_MODE_NEON
	select CRYPTO_ALGAPI
	select CRYPTO_AES
	select CRYPTO_AEAD

config CRYPTO_AES_ARM64_CE_BLK
	tristate "AES in ECB/CBC/CTR/XTS modes using ARMv8 Crypto Extensions"
	depends on ARM64 && KERNEL_MODE_NEON
	select CRYPTO_BLKCIPHER
	select CRYPTO_AES
	select CRYPTO_ABLK_HELPER

config CRYPTO_AES_ARM64_NEON_BLK
	tristate "AES in ECB/CBC/CTR/XTS modes using NEON instructions"
	depends on ARM64 && KERNEL_MODE_NEON
	select CRYPTO_BLKCIPHER
	select CRYPTO_AES
	select CRYPTO_ABLK_HELPER

config CRYPTO_CRC32_ARM64
	tristate "CRC32 and CRC32C using optional ARMv8 instructions"
	depends on ARM64
	select CRYPTO_HASH

config CRYPTO_CHACHA20_NEON
	tristate "NEON accelerated ChaCha and XChaCha stream ciphers"
	depends on KERNEL_MODE_NEON
	select CRYPTO_BLKCIPHER
	select CRYPTO_CHACHA20
	help
	  Implementasi ChaCha20, XChaCha20, dan XChaCha12 berbantuan NEON untuk
	  arm64. Berguna terutama pada CPU tanpa ARMv8 Crypto Extensions, di mana
	  Adiantum dipakai menggantikan AES-XTS; ChaCha adalah komponen terberat
	  Adiantum.


config CRYPTO_NHPOLY1305_NEON
	tristate "NEON accelerated NHPoly1305 hash function (for Adiantum)"
	depends on KERNEL_MODE_NEON
	select CRYPTO_NHPOLY1305
	help
	  Implementasi NHPoly1305 berbantuan NEON untuk arm64. NHPoly1305 adalah
	  fungsi hash ε-almost-∆-universal yang dipakai Adiantum; setelah ChaCha
	  memakai NEON, inilah komponen C generik terberat yang tersisa.

endif
```
